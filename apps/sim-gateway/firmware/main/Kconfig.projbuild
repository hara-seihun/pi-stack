## apps/sim-gateway/firmware/main/Kconfig.projbuild
```kconfig
menu "Kenan SIM gateway (owner-only provisioning)"
config SIM_WIFI_SSID
    string "2.4 GHz Wi-Fi SSID"
    default ""
config SIM_WIFI_PASSWORD
    string "Wi-Fi password"
    default ""
config SIM_PHONE_BDA
    string "Allowed phone Classic Bluetooth address AA:BB:CC:DD:EE:FF"
    default ""
config SIM_SERVER_URL
    string "Gateway WebSocket URL"
    default "wss://calls.kenan.works/gateway/connect"
config SIM_GATEWAY_ID
    string "Provisioned gateway ID"
    default ""
config SIM_DEVICE_TOKEN
    string "Device-specific gateway token (never an administrator token)"
    default ""
endmenu
```

## apps/sim-gateway/firmware/sdkconfig.defaults
```kconfig
CONFIG_IDF_TARGET="esp32"
CONFIG_ESPTOOLPY_FLASHSIZE_4MB=y
CONFIG_PARTITION_TABLE_SINGLE_APP_LARGE=y
CONFIG_BT_ENABLED=y
CONFIG_BT_BLE_ENABLED=n
CONFIG_BTDM_CTRL_MODE_BR_EDR_ONLY=y
CONFIG_BTDM_CTRL_BR_EDR_MAX_SYNC_CONN=1
CONFIG_BT_BLUEDROID_ENABLED=y
CONFIG_BT_CLASSIC_ENABLED=y
CONFIG_BT_HFP_ENABLE=y
CONFIG_BT_HFP_CLIENT_ENABLE=y
CONFIG_BT_HFP_AG_ENABLE=n
CONFIG_BT_HFP_AUDIO_DATA_PATH_HCI=y
CONFIG_BTDM_CTRL_BR_EDR_SCO_DATA_PATH_HCI=y
CONFIG_BT_HFP_WBS_ENABLE=y
CONFIG_BTDM_CTRL_PINNED_TO_CORE_1=y
CONFIG_BT_BLUEDROID_PINNED_TO_CORE_1=y
CONFIG_ESP_WIFI_TASK_PINNED_TO_CORE_0=y
CONFIG_ESP_COEX_SW_COEXIST_ENABLE=y
CONFIG_MBEDTLS_CERTIFICATE_BUNDLE=y
CONFIG_MBEDTLS_CERTIFICATE_BUNDLE_DEFAULT_FULL=y
CONFIG_LOG_DEFAULT_LEVEL_WARN=y
CONFIG_BT_LOG_HCI_TRACE_LEVEL_NONE=y
CONFIG_BT_LOG_BTC_TRACE_LEVEL_NONE=y
CONFIG_BT_LOG_BTM_TRACE_LEVEL_NONE=y
```
